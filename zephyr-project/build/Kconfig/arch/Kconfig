## zephyr-project/build/Kconfig/arch/Kconfig
```kconfig
# Load arch Kconfig descriptions.
osource "C:/Users/steve/Desktop/Repositories/blinky/zephyr-project/zephyr/arch/x86/Kconfig"
osource "C:/Users/steve/Desktop/Repositories/blinky/zephyr-project/zephyr/arch/xtensa/Kconfig"
osource "C:/Users/steve/Desktop/Repositories/blinky/zephyr-project/zephyr/arch/sparc/Kconfig"
osource "C:/Users/steve/Desktop/Repositories/blinky/zephyr-project/zephyr/arch/riscv/Kconfig"
osource "C:/Users/steve/Desktop/Repositories/blinky/zephyr-project/zephyr/arch/posix/Kconfig"
osource "C:/Users/steve/Desktop/Repositories/blinky/zephyr-project/zephyr/arch/nios2/Kconfig"
osource "C:/Users/steve/Desktop/Repositories/blinky/zephyr-project/zephyr/arch/mips/Kconfig"
osource "C:/Users/steve/Desktop/Repositories/blinky/zephyr-project/zephyr/arch/arm64/Kconfig"
osource "C:/Users/steve/Desktop/Repositories/blinky/zephyr-project/zephyr/arch/arm/Kconfig"
osource "C:/Users/steve/Desktop/Repositories/blinky/zephyr-project/zephyr/arch/arc/Kconfig"
```
